## boards/Kconfig
```kconfig
rsource "arm/marvell_mw302/Kconfig.marvell_mw302"
rsource "arm/marvell_mw302/Kconfig.marvell_mw302_ram"
```

## boards/arm/marvell_mw302/Kconfig.defconfig
```kconfig
if BOARD_MARVELL_MW302 || BOARD_GENIE_IDCM || BOARD_MARVELL_MW302_RAM || BOARD_GENIE_IDCM_RAM

config BOARD
	default "marvell_mw302" if BOARD_MARVELL_MW302
	default "genie_idcm" if BOARD_GENIE_IDCM
	default "marvell_mw302_ram" if BOARD_MARVELL_MW302_RAM

endif
```

## boards/arm/marvell_mw302/board.yml
```yaml
boards:
  - name: marvell_mw302
    full_name: Marvell MW302 Development Board
    vendor: marvell
    socs:
      - name: 88mw320
  - name: marvell_mw302_ram
    full_name: Marvell MW302 RAM Execution
    vendor: marvell
    socs:
      - name: 88mw320
  - name: genie_idcm
    full_name: Genie Integrated Door Control Module Board 39732R.S
    vendor: marvell
    socs:
      - name: 88mw320
    full_name: Genie Integrated Door Control Module Board 39732R.S RAM Execution
    vendor: marvell
    socs:
      - name: 88mw320
```

## boards/arm/marvell_mw302/genie_idcm_88mw320_cpu0_defconfig
```kconfig
CONFIG_CORTEX_M_SYSTICK=y
CONFIG_SERIAL=y
CONFIG_CONSOLE=y
CONFIG_UART_CONSOLE=y
CONFIG_GPIO=y
CONFIG_CODE_DATA_RELOCATION=y
CONFIG_GPIO_HOGS=y
CONFIG_MCUBOOT_SIGNATURE_KEY_FILE="bootloader/mcuboot/root-rsa-2048.pem"
CONFIG_RETAINED_MEM=y
CONFIG_RETENTION=y
CONFIG_RETENTION_BOOTLOADER_INFO=y
CONFIG_RETENTION_BOOTLOADER_INFO_TYPE_MCUBOOT=y
```

## boards/arm/marvell_mw302/marvell_mw302.defconfig
```kconfig
CONFIG_CODE_DATA_RELOCATION=y
CONFIG_CODE_DATA_RELOCATION_SRAM=y
# UART console
CONFIG_UART_CONSOLE=y
# GPIO
CONFIG_GPIO=y
```

## boards/arm/marvell_mw302/marvell_mw302_88mw320_cpu0_defconfig
```kconfig
CONFIG_CORTEX_M_SYSTICK=y
CONFIG_SERIAL=y
CONFIG_CONSOLE=y
CONFIG_UART_CONSOLE=y
CONFIG_GPIO=y
```

## boards/native_sim_native_64.conf
```kconfig
# Disable MW320 hardware
CONFIG_WIFI_MW320=n

# Use Native Socket Offload (Host networking) instead of TAP
CONFIG_NET_DRIVERS=y
CONFIG_NET_SOCKETS_OFFLOAD=y
CONFIG_NET_NATIVE_OFFLOADED_SOCKETS=y
CONFIG_ETH_NATIVE_TAP=n
CONFIG_NET_L2_ETHERNET=n

# Disable sysbuild mcuboot requirements
CONFIG_BOOTLOADER_MCUBOOT=n
CONFIG_BUILD_OUTPUT_BIN=n
CONFIG_UART_CONSOLE=n
CONFIG_POSIX_ARCH_CONSOLE=y
CONFIG_LOG_BACKEND_UART=n
CONFIG_LOG_BACKEND_NATIVE_POSIX=y
CONFIG_LOG_MODE_IMMEDIATE=y
```

## drivers/Kconfig
```kconfig
rsource "gpio/Kconfig"
rsource "serial/Kconfig"
rsource "entropy/Kconfig"
rsource "pinctrl/Kconfig"
rsource "wifi/mw320/Kconfig"
rsource "watchdog/Kconfig"
rsource "flash/Kconfig"
rsource "counter/Kconfig"
rsource "bbram/Kconfig"
```

## drivers/bbram/Kconfig
```kconfig
config BBRAM_MW320
	bool "Marvell MW320 Battery-Backed / Retention RAM Driver"
	default y
	depends on DT_HAS_NXP_MW320_BBRAM_ENABLED
	select BBRAM
	help
	  Enable support for Marvell MW320 PMU AON retention RAM.
```

## drivers/counter/Kconfig
```kconfig
config COUNTER_MW320
	bool "Marvell MW320 RTC Counter Driver"
	default y
	depends on DT_HAS_NXP_MW320_RTC_ENABLED
	select COUNTER
	help
	  Enable support for Marvell MW320 RTC counter driver.
```

## drivers/entropy/Kconfig
```kconfig
config ENTROPY_MW320
	bool "NXP MW320 Entropy driver"
	default y
	depends on DT_HAS_MARVELL_MW320_ENTROPY_ENABLED
	select ENTROPY_HAS_DRIVER
	help
	  Enable the Entropy driver for NXP MW320 SoCs.
```

## drivers/flash/Kconfig
```kconfig
config FLASH_MW320
	bool "MW320 Flash driver"
	default y
	depends on DT_HAS_SOC_NV_FLASH_ENABLED
	select FLASH_HAS_DRIVER_ENABLED
	select FLASH_HAS_PAGE_LAYOUT
	select FLASH_HAS_EXPLICIT_ERASE
	help
	  Enable MW320 Flash driver.
```

## drivers/gpio/Kconfig
```kconfig
config GPIO_MW320
	bool "NXP MW320 GPIO driver"
	default y
	depends on DT_HAS_NXP_MW320_GPIO_ENABLED
	help
	  Enable the GPIO driver for NXP MW320 SoCs.
```

## drivers/pinctrl/Kconfig
```kconfig
# Copyright (c) 2026
# SPDX-License-Identifier: Apache-2.0

config PINCTRL_MW320
    bool "NXP MW320 pin controller driver"
    default y
    depends on DT_HAS_NXP_MW320_PINCTRL_ENABLED
    help
      Enable pin controller driver for Marvell MW320.
```

## drivers/serial/Kconfig
```kconfig
config UART_MW320
	bool "NXP MW320 UART driver"
	default y
	depends on DT_HAS_NXP_MW320_UART_ENABLED
	depends on SERIAL
	select SERIAL_HAS_DRIVER
	select SERIAL_SUPPORT_INTERRUPT
	help
	  Enable the UART driver for NXP MW320 SoCs.
```

## drivers/watchdog/Kconfig
```kconfig
config WATCHDOG_MW320
	bool "Marvell MW320 Watchdog Timer Driver"
	default y
	depends on DT_HAS_NXP_MW320_WDT_ENABLED
	help
	  Enable the Watchdog driver for Marvell MW320.
```

## drivers/wifi/mw320/Kconfig
```kconfig
config WIFI_MW320
	bool "NXP MW320 WiFi driver"
	default y
	depends on WIFI
	depends on SOC_88MW320
	select WIFI_OFFLOAD
	help
	  Enable the Zephyr L2 WiFi driver for NXP MW320 (wlcmgr wrapper).
```

## dts/bindings/serial/nxp,mw320-uart.yaml
```yaml
description: NXP MW320 UART
compatible: "nxp,mw320-uart"
include: [uart-controller.yaml, base.yaml]
properties:
  reg:
    required: true
  interrupts:
    required: true
```

## dts/bindings/watchdog/nxp,mw320-wdt.yaml
```yaml
description: NXP MW320 Watchdog Timer

compatible: "nxp,mw320-wdt"

include: base.yaml

properties:
  reg:
    required: true
  interrupts:
    required: true
```

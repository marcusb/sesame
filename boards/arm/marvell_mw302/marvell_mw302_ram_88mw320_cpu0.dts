/dts-v1/;
#include "marvell_mw302_88mw320_cpu0.dts"

/ {
	model = "Marvell MW302 RAM Execution";
	compatible = "marvell,mw302-ram", "nxp,88mw320";

	chosen {
		zephyr,sram = &sram0;
		/delete-property/ zephyr,flash;
	};
};

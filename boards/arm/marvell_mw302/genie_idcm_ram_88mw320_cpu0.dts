/dts-v1/;
#include "genie_idcm_88mw320_cpu0.dts"

/ {
	model = "Genie Integrated Door Control Module Board 39732R.S RAM Execution";
	compatible = "marvell,mw302-ram", "nxp,88mw320";

	chosen {
		zephyr,sram = &sram0;
		/delete-property/ zephyr,flash;
	};
};

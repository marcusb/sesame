## mcuboot_module/Kconfig
```kconfig
menu "MW320 Custom Drivers"

rsource "../drivers/flash/Kconfig"
rsource "../drivers/serial/Kconfig"
rsource "../drivers/gpio/Kconfig"
rsource "../drivers/pinctrl/Kconfig"

endmenu

config MW320_MCUBOOT_FIX
    bool
    default y
    select HAS_FLASH_LOAD_OFFSET
```

## modules/mw320_sdk/zephyr/Kconfig
```kconfig
config HAS_MW320_SDK
	bool
	help
	  Set if the MW320 SDK is present in the workspace.
```

## soc/nxp/88mw320/Kconfig.defconfig
```kconfig
if SOC_88MW320

config NUM_IRQS
	default 48

config SYS_CLOCK_HW_CYCLES_PER_SEC
	default 200000000

config SERIAL_HAS_DRIVER
	def_bool y

config UART_MW320
	bool
	default y
	depends on DT_HAS_NXP_MW320_UART_ENABLED && SERIAL

config GPIO_MW320
	bool
	default y
	depends on DT_HAS_NXP_MW320_GPIO_ENABLED

config ENTROPY_MW320
	bool
	default y
	depends on DT_HAS_MARVELL_MW320_ENTROPY_ENABLED

config WIFI_MW320
	bool
	default y
	depends on WIFI
	select WIFI_OFFLOAD




endif # SOC_88MW320
```

## soc/nxp/88mw320/Kconfig.soc
```kconfig
config SOC_88MW320
	bool
	select ARM
	select CPU_CORTEX_M4
	select CPU_HAS_FPU
	select CPU_HAS_ARM_MPU
	select CPU_CORTEX_M_HAS_DWT
	select CPU_CORTEX_M_HAS_SYSTICK
	select PINCTRL

config SOC
	default "88mw320" if SOC_88MW320
```

## tests/pic_test/testcase.yaml
```yaml
tests:
  pic_test.hardware:
    platform_allow:
      - genie_idcm_ram/88mw320/cpu0
    harness: ztest
    tags: pic hardware
```

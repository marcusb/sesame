#include "mcuboot_updater.h"

#include <errno.h>
#include <stdlib.h>
#include <string.h>
#include <zephyr/device.h>
#include <zephyr/devicetree.h>
#include <zephyr/drivers/flash.h>
#include <zephyr/kernel.h>
#include <zephyr/logging/log.h>
#include <zephyr/storage/flash_map.h>
#include <zephyr/sys/reboot.h>

#include "boot_utils.h"
#include "mcuboot_info.h"
#include "partition.h"

LOG_MODULE_REGISTER(mcuboot_upd, LOG_LEVEL_INF);

/* Marvell firmware structures as generated by axf2firmware */
#define MRVL_FW_MAGIC_STR 0x4C56524D /* "MRVL" in little-endian */
#define MRVL_FW_MAGIC_SIG 0x2E9CF17B

struct img_hdr {
    uint32_t magic_str;
    uint32_t magic_sig;
    uint32_t time;
    uint32_t seg_cnt;
    uint32_t entry;
} __attribute__((packed));

struct seg_hdr {
    uint32_t type;
    uint32_t offset;
    uint32_t len;
    uint32_t laddr;
    uint32_t crc;
} __attribute__((packed));

static const struct device* get_flash_dev(void) {
    const struct device* dev = NULL;
#if DT_HAS_COMPAT_STATUS_OKAY(nxp_mw320_flash_controller)
    dev = DEVICE_DT_GET_ONE(nxp_mw320_flash_controller);
#elif DT_NODE_EXISTS(DT_CHOSEN(zephyr_flash_controller))
    dev = DEVICE_DT_GET(DT_CHOSEN(zephyr_flash_controller));
#endif
    if (!dev || !device_is_ready(dev)) {
        return NULL;
    }
    return dev;
}

int mcuboot_validate_image(const uint8_t* data, size_t len) {
    if (len < sizeof(struct img_hdr) || len > MCUBOOT_MAX_IMG_SIZE) {
        LOG_ERR("Invalid image size: %zu bytes", len);
        return -EINVAL;
    }

    const struct img_hdr* ihdr = (const struct img_hdr*)data;
    if (ihdr->magic_str != MRVL_FW_MAGIC_STR) {
        LOG_ERR("Invalid magic string: 0x%08x (expected 0x%08x)",
                ihdr->magic_str, MRVL_FW_MAGIC_STR);
        return -EBADMSG;
    }
    if (ihdr->magic_sig != MRVL_FW_MAGIC_SIG) {
        LOG_ERR("Invalid magic signature: 0x%08x (expected 0x%08x)",
                ihdr->magic_sig, MRVL_FW_MAGIC_SIG);
        return -EBADMSG;
    }

    if (ihdr->seg_cnt == 0 || ihdr->seg_cnt > 16) {
        LOG_ERR("Invalid segment count: %u", ihdr->seg_cnt);
        return -EBADMSG;
    }

    size_t min_hdr_size =
        sizeof(struct img_hdr) + (ihdr->seg_cnt * sizeof(struct seg_hdr));
    if (len < min_hdr_size) {
        LOG_ERR("Image truncated before segment headers (%zu < %zu)", len,
                min_hdr_size);
        return -EBADMSG;
    }

    const struct seg_hdr* shdrs =
        (const struct seg_hdr*)(data + sizeof(struct img_hdr));
    for (uint32_t i = 0; i < ihdr->seg_cnt; i++) {
        if (shdrs[i].offset + shdrs[i].len > len) {
            LOG_ERR("Segment %u extends past end of image (%u + %u > %zu)", i,
                    shdrs[i].offset, shdrs[i].len, len);
            return -EBADMSG;
        }

        uint32_t computed_crc =
            partition_calc_crc32(data + shdrs[i].offset, shdrs[i].len);
        if (computed_crc != shdrs[i].crc) {
            LOG_ERR("Segment %u CRC mismatch (calc 0x%08x != hdr 0x%08x)", i,
                    computed_crc, shdrs[i].crc);
            return -EBADMSG;
        }
    }

    LOG_INF("MCUboot image validated successfully: %zu bytes, %u segments", len,
            ihdr->seg_cnt);
    return 0;
}

static uint8_t* s_ram_buf = NULL;
static size_t s_ram_buf_len = 0;

void mcuboot_updater_reset(void) {
    if (s_ram_buf) {
        free(s_ram_buf);
        s_ram_buf = NULL;
    }
    s_ram_buf_len = 0;
}

void mcuboot_updater_abort(void) {
    LOG_WRN("Aborting MCUboot update");
    mcuboot_updater_reset();
}

int mcuboot_updater_process_chunk(const uint8_t* data, size_t len) {
    if (len == 0) {
        return 0;
    }
    if (s_ram_buf_len + len > MCUBOOT_MAX_IMG_SIZE) {
        LOG_ERR("Chunk exceeds MCUboot partition capacity (%zu + %zu > %d)",
                s_ram_buf_len, len, MCUBOOT_MAX_IMG_SIZE);
        return -ENOMEM;
    }

    uint8_t* new_buf = realloc(s_ram_buf, s_ram_buf_len + len);
    if (!new_buf) {
        LOG_ERR("Failed to allocate RAM buffer for chunk (%zu bytes)",
                s_ram_buf_len + len);
        return -ENOMEM;
    }
    s_ram_buf = new_buf;
    memcpy(s_ram_buf + s_ram_buf_len, data, len);
    s_ram_buf_len += len;
    return 0;
}

int mcuboot_updater_complete(void) {
    if (!s_ram_buf || s_ram_buf_len == 0) {
        LOG_ERR("No image data received");
        mcuboot_updater_reset();
        return -ENODATA;
    }

    int rc = mcuboot_validate_image(s_ram_buf, s_ram_buf_len);
    if (rc != 0) {
        LOG_ERR("Validation failed (%d); rejecting update", rc);
        mcuboot_updater_reset();
        return rc;
    }

    const struct device* flash_dev = get_flash_dev();
    if (!flash_dev) {
        LOG_ERR("Flash device not ready");
        mcuboot_updater_reset();
        return -ENODEV;
    }

    uint32_t active_slot = g_mcuboot_info.slot;
    uint32_t target_slot = active_slot ^ 1;
    uint32_t target_addr =
        (target_slot == 0) ? MCUBOOT_SLOT_0_ADDR : MCUBOOT_SLOT_1_ADDR;

    size_t erase_size = ROUND_UP(s_ram_buf_len, 4096);
    if (erase_size > MCUBOOT_SLOT_SIZE) {
        erase_size = MCUBOOT_SLOT_SIZE;
    }

    LOG_INF(
        "Flashing new MCUboot image to slot %u @ 0x%05x (%zu bytes, erasing "
        "%zu)...",
        target_slot, target_addr, s_ram_buf_len, erase_size);

    rc = flash_erase(flash_dev, target_addr, erase_size);
    if (rc != 0) {
        LOG_ERR("Flash erase failed: %d", rc);
        mcuboot_updater_reset();
        return -EIO;
    }

    rc = flash_write(flash_dev, target_addr, s_ram_buf, s_ram_buf_len);
    if (rc != 0) {
        LOG_ERR("Flash write failed: %d", rc);
        mcuboot_updater_reset();
        return -EIO;
    }

    /* Read back and verify image */
    uint8_t verify_chunk[256];
    size_t verified = 0;
    while (verified < s_ram_buf_len) {
        size_t to_read = sizeof(verify_chunk);
        if (verified + to_read > s_ram_buf_len) {
            to_read = s_ram_buf_len - verified;
        }
        rc = flash_read(flash_dev, target_addr + verified, verify_chunk,
                        to_read);
        if (rc != 0 ||
            memcmp(verify_chunk, s_ram_buf + verified, to_read) != 0) {
            LOG_ERR("Flash verification mismatch at offset %zu!", verified);
            mcuboot_updater_reset();
            return -EIO;
        }
        verified += to_read;
    }

    /* Update Boot2 partition table: set target slot gen_level to
     * OTA_TEST_MODE_FLAG */
    struct boot2_partition_table pt_hdr;
    struct boot2_partition_entry entries[BOOT2_PART_MAX_ENTRIES];
    rc = partition_read_active_table(&pt_hdr, entries, BOOT2_PART_MAX_ENTRIES);
    if (rc != 0) {
        LOG_ERR("Failed to read active partition table: %d", rc);
        mcuboot_updater_reset();
        return -EIO;
    }

    int fw_indices[2] = {-1, -1};
    int fw_count = partition_find_fw_entries(
        entries, pt_hdr.partition_entries_no, fw_indices);
    if (fw_count == 2 && target_slot < 2 && fw_indices[target_slot] >= 0) {
        int tgt_idx = fw_indices[target_slot];
        entries[tgt_idx].gen_level = OTA_TEST_MODE_FLAG;
        pt_hdr.gen_level++;

        uint32_t passive_pt_addr = 0;
        partition_get_table_addrs(NULL, &passive_pt_addr);

        rc = partition_write_table(passive_pt_addr, &pt_hdr, entries);
        if (rc != 0) {
            LOG_ERR("Failed to write updated partition table: %d", rc);
            mcuboot_updater_reset();
            return -EIO;
        }

        LOG_INF(
            "Updated Boot2 partition table written to 0x%04x: slot %u "
            "gen_level=0x%08x",
            passive_pt_addr, target_slot, entries[tgt_idx].gen_level);
    } else {
        LOG_ERR("Expected 2 firmware partitions, found %d!", fw_count);
        mcuboot_updater_reset();
        return -EINVAL;
    }

    LOG_INF("MCUboot A/B update complete! Rebooting into slot %u for test...",
            target_slot);
    mcuboot_updater_reset();
    return 0;
}

int mcuboot_updater_promote(void) {
    uint32_t slot = g_mcuboot_info.slot;

    struct boot2_partition_table pt_hdr;
    struct boot2_partition_entry entries[BOOT2_PART_MAX_ENTRIES];
    int rc =
        partition_read_active_table(&pt_hdr, entries, BOOT2_PART_MAX_ENTRIES);
    if (rc != 0) {
        LOG_ERR("Failed to read active partition table for promotion: %d", rc);
        return -EIO;
    }

    int fw_indices[2] = {-1, -1};
    int fw_count = partition_find_fw_entries(
        entries, pt_hdr.partition_entries_no, fw_indices);
    if (fw_count != 2 || slot >= 2 || fw_indices[slot] < 0) {
        LOG_ERR("Cannot promote: invalid FW partitions (count=%d, slot=%u)",
                fw_count, slot);
        return -EINVAL;
    }

    int act_idx = fw_indices[slot];
    int other_idx = fw_indices[slot ^ 1];
    uint32_t other_gen = entries[other_idx].gen_level;
    uint32_t new_gen = other_gen + 1;

    entries[act_idx].gen_level = new_gen;
    pt_hdr.gen_level++;

    uint32_t passive_pt_addr = 0;
    partition_get_table_addrs(NULL, &passive_pt_addr);

    rc = partition_write_table(passive_pt_addr, &pt_hdr, entries);
    if (rc != 0) {
        LOG_ERR("Failed to write promoted partition table: %d", rc);
        return -EIO;
    }

    g_mcuboot_info.gen_level = new_gen;
    g_mcuboot_info.confirmed = 1;
    boot_info_write(g_mcuboot_info.version_str, slot, new_gen, 1);

    LOG_INF(
        "MCUboot slot %u successfully promoted to confirmed (gen_level=%u)!",
        slot, new_gen);
    return 0;
}
